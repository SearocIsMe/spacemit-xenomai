## configs/k1_dovetail_noidle_defconfig
```kconfig
# =============================================================================
# k1_dovetail_noidle_defconfig
# Keep SMP enabled, but disable idle/tick-broadcast features to distinguish
# "IPI/SMP issue" from "idle/tick-broadcast issue" in Dovetail bring-up.
# =============================================================================

CONFIG_LOCALVERSION=""
# CONFIG_LOCALVERSION_AUTO is not set

CONFIG_DOVETAIL=y
CONFIG_IRQ_PIPELINE=y
# CONFIG_EVL is not set

CONFIG_HIGH_RES_TIMERS=y
CONFIG_HZ_1000=y
CONFIG_HZ=1000
CONFIG_PREEMPT=y

# Keep this bisect variant out of the platform suspend path: once
# CPU_IDLE is disabled, RISC-V stops providing CPU_PM helpers that
# SpacemiT's PM objects expect at link time.
# CONFIG_PM is not set
# CONFIG_SUSPEND is not set
# CONFIG_PM_SLEEP is not set
# CONFIG_SPACEMIT_LID_CONTROL is not set
# CONFIG_SPACEMIT_WATCHDOG is not set

CONFIG_SMP=y
CONFIG_HOTPLUG_CPU=y

# Remove idle/tick-broadcast interactions first.
# CONFIG_CPU_IDLE is not set
# CONFIG_NO_HZ_IDLE is not set
# CONFIG_GENERIC_CLOCKEVENTS_BROADCAST is not set

# Disable known-broken vendor Wi-Fi modules for current toolchains.
# CONFIG_BCMDHD is not set
# CONFIG_RTL8852BS is not set
```

## configs/k1_dovetail_nosmp_defconfig
```kconfig
# =============================================================================
# k1_dovetail_nosmp_defconfig
# Dovetail/IRQ pipeline enabled, but disable SMP and related cross-CPU/tick
# broadcast paths to isolate early boot issues around IPIs and broadcast ticks.
# =============================================================================

CONFIG_LOCALVERSION=""
# CONFIG_LOCALVERSION_AUTO is not set

CONFIG_DOVETAIL=y
CONFIG_IRQ_PIPELINE=y
# CONFIG_EVL is not set

CONFIG_HIGH_RES_TIMERS=y
CONFIG_HZ_1000=y
CONFIG_HZ=1000
CONFIG_PREEMPT=y

# Keep this bisect variant out of the platform suspend path: once
# CPU_IDLE is disabled, RISC-V stops providing CPU_PM helpers that
# SpacemiT's PM objects expect at link time.
# CONFIG_PM is not set
# CONFIG_SUSPEND is not set
# CONFIG_PM_SLEEP is not set
# CONFIG_SPACEMIT_LID_CONTROL is not set
# CONFIG_SPACEMIT_WATCHDOG is not set

# Collapse the platform to a single CPU to avoid OOB IPI/SMP paths.
# CONFIG_SMP is not set
# CONFIG_HOTPLUG_CPU is not set

# Remove tick/idle paths that interact with broadcast IPIs in early boot.
# CONFIG_CPU_IDLE is not set
# CONFIG_NO_HZ_IDLE is not set
# CONFIG_GENERIC_CLOCKEVENTS_BROADCAST is not set

# Disable known-broken vendor Wi-Fi modules for current toolchains.
# CONFIG_BCMDHD is not set
# CONFIG_RTL8852BS is not set
```

## configs/k1_dovetail_only_defconfig
```kconfig
# =============================================================================
# k1_dovetail_only_defconfig
# Enable only the Dovetail/IRQ pipeline layer without EVL core.
# This isolates early boot issues caused by the interrupt pipeline itself.
# =============================================================================

CONFIG_LOCALVERSION=""
# CONFIG_LOCALVERSION_AUTO is not set

CONFIG_DOVETAIL=y
CONFIG_IRQ_PIPELINE=y
# CONFIG_EVL is not set

CONFIG_HIGH_RES_TIMERS=y
CONFIG_HZ_1000=y
CONFIG_HZ=1000
CONFIG_PREEMPT=y

# Disable known-broken vendor Wi-Fi modules for current toolchains.
# CONFIG_BCMDHD is not set
# CONFIG_RTL8852BS is not set
```

## configs/k1_evl_defconfig
```kconfig
# =============================================================================
# k1_evl_defconfig
# Kernel config fragment for enabling Xenomai 4 / EVL on SpacemiT K1.
#
# This fragment is MERGED on top of spacemit_k1_v2_defconfig by
# scripts/build/02-configure.sh using merge_config.sh.
#
# Do NOT use this as a standalone defconfig — it only sets EVL-specific
# options and overrides that differ from the SpacemiT base config.
# =============================================================================

# -----------------------------------------------------------------------------
# Core EVL / Dovetail requirements
# -----------------------------------------------------------------------------

# Dovetail interrupt pipeline (prerequisite for EVL)
CONFIG_DOVETAIL=y
CONFIG_IRQ_PIPELINE=y

# EVL core
CONFIG_EVL_CORE=y

# EVL scheduler policies
CONFIG_EVL_SCHED_QUOTA=y
CONFIG_EVL_SCHED_TP=y

# EVL heap allocator
CONFIG_EVL_HEAP=y

# EVL proxy driver (for bridging in-band and OOB I/O)
CONFIG_EVL_PROXY=y

# EVL poll support
CONFIG_EVL_POLL=y

# EVL observable (event notification)
CONFIG_EVL_OBSERVABLE=y

# EVL cross-buffer (zero-copy data transfer)
CONFIG_EVL_XBUF=y

# EVL latency monitor
CONFIG_EVL_LATMON=y

# -----------------------------------------------------------------------------
# Timer / clock requirements
# -----------------------------------------------------------------------------

# High-resolution timers (mandatory for EVL)
CONFIG_HIGH_RES_TIMERS=y

# 1000 Hz tick rate for better latency
CONFIG_HZ_1000=y
CONFIG_HZ=1000

# Disable dynamic tick (NO_HZ) in OOB context — use full tick for RT
# Note: NOHZ_FULL can interfere with EVL timer delivery
CONFIG_NO_HZ_IDLE=y
# CONFIG_NO_HZ_FULL is not set

# -----------------------------------------------------------------------------
# Preemption model
# -----------------------------------------------------------------------------

# Full preemption required for EVL
CONFIG_PREEMPT=y
# CONFIG_PREEMPT_NONE is not set
# CONFIG_PREEMPT_VOLUNTARY is not set

# -----------------------------------------------------------------------------
# RISC-V specific
# -----------------------------------------------------------------------------

# FPU support (required for OOB thread FPU context)
CONFIG_FPU=y

# Disable Vector extension in OOB context (not yet supported by EVL)
# CONFIG_RISCV_ISA_V is not set  # Uncomment if V-ext causes issues

# -----------------------------------------------------------------------------
# Debugging (enable during initial bring-up, disable for production)
# -----------------------------------------------------------------------------

# EVL latency tracing
CONFIG_EVL_LATENCY_USER=y

# Kernel latency tracer (ftrace-based)
CONFIG_FTRACE=y
CONFIG_FUNCTION_TRACER=y
CONFIG_IRQSOFF_TRACER=y
CONFIG_PREEMPT_TRACER=y
CONFIG_HWLAT_TRACER=y

# Lock debugging (disable for production — adds overhead)
# CONFIG_LOCKDEP is not set
# CONFIG_DEBUG_MUTEXES is not set

# EVL sanity checks (disable for production)
CONFIG_EVL_DEBUG_CORE=y
# CONFIG_EVL_DEBUG_MEMORY is not set  # Very slow — only for memory debugging

# -----------------------------------------------------------------------------
# Networking (optional — for EVL-based fieldbus over Ethernet)
# -----------------------------------------------------------------------------

# Raw socket support (needed for EtherCAT-style protocols)
CONFIG_PACKET=y

# -----------------------------------------------------------------------------
# Disable options that conflict with EVL
# -----------------------------------------------------------------------------

# PREEMPT_RT is mutually exclusive with EVL/Dovetail
# CONFIG_PREEMPT_RT is not set

# NOTE: Do NOT disable CONFIG_CPU_FREQ here — SpacemiT MMC driver
# (sdhci-of-k1x) calls cpufreq_generic_get() and requires CPU_FREQ=y.
# If you observe latency spikes from cpufreq, use the cpufreq governor
# 'performance' at runtime instead: cpupower frequency-set -g performance

# Disable vendor WiFi drivers that fail to build with GCC 13+:
#   - bcmdhd: uses #include <typedefs.h> (missing include path with new toolchain)
#   - rtl8852bs: uses CONFIG_LITTLE_ENDIAN (wrong symbol; RISC-V uses CPU_LITTLE_ENDIAN)
# These are not needed for real-time EVL work.
# CONFIG_BCMDHD is not set
# CONFIG_RTL8852BS is not set
```

## configs/k1_evl_off_defconfig
```kconfig
# =============================================================================
# k1_evl_off_defconfig
# Keep Dovetail/IRQ pipeline enabled but disable EVL core and optional EVL
# services. Useful to distinguish "pipeline breaks boot" from "EVL breaks boot".
# =============================================================================

CONFIG_LOCALVERSION=""
# CONFIG_LOCALVERSION_AUTO is not set

CONFIG_DOVETAIL=y
CONFIG_IRQ_PIPELINE=y
# CONFIG_EVL is not set

# Belt-and-suspenders: make sure optional EVL subsystems stay off too.
# CONFIG_EVL_SCHED_QUOTA is not set
# CONFIG_EVL_SCHED_TP is not set
# CONFIG_EVL_PROXY is not set
# CONFIG_EVL_POLL is not set
# CONFIG_EVL_OBSERVABLE is not set
# CONFIG_EVL_XBUF is not set
# CONFIG_EVL_LATMON is not set
# CONFIG_EVL_DEBUG_CORE is not set

CONFIG_HIGH_RES_TIMERS=y
CONFIG_HZ_1000=y
CONFIG_HZ=1000
CONFIG_PREEMPT=y

# Disable known-broken vendor Wi-Fi modules for current toolchains.
# CONFIG_BCMDHD is not set
# CONFIG_RTL8852BS is not set
```

## configs/k1_irq_pipeline_minimal_defconfig
```kconfig
# =============================================================================
# k1_irq_pipeline_minimal_defconfig
# Smallest practical Jupiter bring-up slice for IRQ pipeline debugging:
#   - IRQ pipeline enabled
#   - no Dovetail
#   - no EVL
#   - no SMP / no IPI fan-out
#   - no idle / no broadcast tick
#   - no PM / suspend path
#   - no FPU / no Vector state
#
# If this variant still hangs, the blocker is likely in the single-core local
# IRQ/timer/trap path itself rather than in SMP, idle, EVL, or FPU handling.
# =============================================================================

CONFIG_LOCALVERSION=""
# CONFIG_LOCALVERSION_AUTO is not set

CONFIG_IRQ_PIPELINE=y
# CONFIG_DOVETAIL is not set
# CONFIG_EVL is not set

CONFIG_HIGH_RES_TIMERS=y
CONFIG_HZ_1000=y
CONFIG_HZ=1000
CONFIG_PREEMPT=y

# Remove platform PM / suspend interactions from the first minimal check.
# CONFIG_PM is not set
# CONFIG_SUSPEND is not set
# CONFIG_PM_SLEEP is not set
# CONFIG_SPACEMIT_LID_CONTROL is not set
# CONFIG_SPACEMIT_WATCHDOG is not set

# Collapse to one CPU so no IPI or cross-CPU pipeline path can trigger.
# CONFIG_SMP is not set
# CONFIG_HOTPLUG_CPU is not set

# Remove idle and broadcast-tick interactions.
# CONFIG_CPU_IDLE is not set
# CONFIG_NO_HZ_IDLE is not set
# CONFIG_GENERIC_CLOCKEVENTS_BROADCAST is not set

# Keep the architecture state model as small as possible.
# CONFIG_FPU is not set
# CONFIG_RISCV_ISA_V is not set

# Disable known-broken vendor Wi-Fi modules for current toolchains.
# CONFIG_BCMDHD is not set
# CONFIG_RTL8852BS is not set
```

## configs/k1_irq_pipeline_noidle_defconfig
```kconfig
# =============================================================================
# k1_irq_pipeline_noidle_defconfig
# IRQ pipeline enabled, Dovetail/EVL disabled, SMP kept on, but disable idle
# and broadcast tick machinery. This separates "basic IRQ pipeline works"
# from "idle/tick-broadcast path breaks boot".
# =============================================================================

CONFIG_LOCALVERSION=""
# CONFIG_LOCALVERSION_AUTO is not set

CONFIG_IRQ_PIPELINE=y
# CONFIG_DOVETAIL is not set
# CONFIG_EVL is not set

CONFIG_HIGH_RES_TIMERS=y
CONFIG_HZ_1000=y
CONFIG_HZ=1000
CONFIG_PREEMPT=y

# Keep suspend/PM out of this diagnostic slice.
# CONFIG_PM is not set
# CONFIG_SUSPEND is not set
# CONFIG_PM_SLEEP is not set
# CONFIG_SPACEMIT_LID_CONTROL is not set
# CONFIG_SPACEMIT_WATCHDOG is not set

CONFIG_SMP=y
CONFIG_HOTPLUG_CPU=y

# Remove idle/tick-broadcast interactions first.
# CONFIG_CPU_IDLE is not set
# CONFIG_NO_HZ_IDLE is not set
# CONFIG_GENERIC_CLOCKEVENTS_BROADCAST is not set

# Disable known-broken vendor Wi-Fi modules for current toolchains.
# CONFIG_BCMDHD is not set
# CONFIG_RTL8852BS is not set
```

## configs/k1_irq_pipeline_nosmp_defconfig
```kconfig
# =============================================================================
# k1_irq_pipeline_nosmp_defconfig
# IRQ pipeline enabled, but keep Dovetail/EVL disabled and collapse the
# platform to a single CPU. This isolates whether the first blocker is in
# SMP/IPI handling rather than the basic single-core interrupt pipeline.
# =============================================================================

CONFIG_LOCALVERSION=""
# CONFIG_LOCALVERSION_AUTO is not set

CONFIG_IRQ_PIPELINE=y
# CONFIG_DOVETAIL is not set
# CONFIG_EVL is not set

CONFIG_HIGH_RES_TIMERS=y
CONFIG_HZ_1000=y
CONFIG_HZ=1000
CONFIG_PREEMPT=y

# Keep this variant out of suspend/idle interactions while we narrow the
# first IRQ-pipeline blocker.
# CONFIG_PM is not set
# CONFIG_SUSPEND is not set
# CONFIG_PM_SLEEP is not set
# CONFIG_SPACEMIT_LID_CONTROL is not set
# CONFIG_SPACEMIT_WATCHDOG is not set

# Collapse to one CPU so no IPI/OOB cross-CPU path can trigger.
# CONFIG_SMP is not set
# CONFIG_HOTPLUG_CPU is not set

# Disable idle/broadcast interactions for the first single-core check.
# CONFIG_CPU_IDLE is not set
# CONFIG_NO_HZ_IDLE is not set
# CONFIG_GENERIC_CLOCKEVENTS_BROADCAST is not set

# Disable known-broken vendor Wi-Fi modules for current toolchains.
# CONFIG_BCMDHD is not set
# CONFIG_RTL8852BS is not set
```

## configs/k1_irq_pipeline_only_defconfig
```kconfig
# =============================================================================
# k1_irq_pipeline_only_defconfig
# Enable the generic IRQ pipeline on RISC-V, but keep Dovetail and EVL off.
# This isolates whether the boot failure is caused by IRQ_PIPELINE itself,
# or by the extra Dovetail glue layered on top of it.
# =============================================================================

CONFIG_LOCALVERSION=""
# CONFIG_LOCALVERSION_AUTO is not set

# Critical bisect point:
CONFIG_IRQ_PIPELINE=y
# CONFIG_DOVETAIL is not set
# CONFIG_EVL is not set

CONFIG_HIGH_RES_TIMERS=y
CONFIG_HZ_1000=y
CONFIG_HZ=1000
CONFIG_PREEMPT=y

# Disable known-broken vendor Wi-Fi modules for current toolchains.
# CONFIG_BCMDHD is not set
# CONFIG_RTL8852BS is not set
```

## configs/k1_irq_pipeline_pmoff_defconfig
```kconfig
# =============================================================================
# k1_irq_pipeline_pmoff_defconfig
# IRQ pipeline enabled, Dovetail/EVL disabled, SMP kept on, but disable the
# platform PM/suspend path and the SBI cpuidle driver first. This helps split
# "generic idle/tick path issue" from "RISC-V SBI cpuidle / PM interaction".
# =============================================================================

CONFIG_LOCALVERSION=""
# CONFIG_LOCALVERSION_AUTO is not set

CONFIG_IRQ_PIPELINE=y
# CONFIG_DOVETAIL is not set
# CONFIG_EVL is not set

CONFIG_HIGH_RES_TIMERS=y
CONFIG_HZ_1000=y
CONFIG_HZ=1000
CONFIG_PREEMPT=y

CONFIG_SMP=y
CONFIG_HOTPLUG_CPU=y

# Remove PM/cpuidle integration first, but keep the rest of the scheduler/tick
# behavior as close as possible to the plain irq-pipeline slice.
# CONFIG_PM is not set
# CONFIG_SUSPEND is not set
# CONFIG_PM_SLEEP is not set
# CONFIG_CPU_PM is not set
# CONFIG_RISCV_SBI_CPUIDLE is not set

# Disable known-broken vendor Wi-Fi modules for current toolchains.
# CONFIG_BCMDHD is not set
# CONFIG_RTL8852BS is not set
```

## configs/k1_irq_pipeline_tickoff_defconfig
```kconfig
# =============================================================================
# k1_irq_pipeline_tickoff_defconfig
# IRQ pipeline enabled, Dovetail/EVL disabled, SMP kept on. Keep CPU idle
# enabled, but disable tickless idle and broadcast clockevent machinery to
# isolate "NO_HZ/broadcast" issues from broader CPU_IDLE integration issues.
# =============================================================================

CONFIG_LOCALVERSION=""
# CONFIG_LOCALVERSION_AUTO is not set

CONFIG_IRQ_PIPELINE=y
# CONFIG_DOVETAIL is not set
# CONFIG_EVL is not set

CONFIG_HIGH_RES_TIMERS=y
CONFIG_HZ_1000=y
CONFIG_HZ=1000
CONFIG_PREEMPT=y

CONFIG_SMP=y
CONFIG_HOTPLUG_CPU=y

# Keep idle enabled, but remove tickless/broadcast behavior first.
CONFIG_HZ_PERIODIC=y
# CONFIG_NO_HZ_IDLE is not set
# CONFIG_GENERIC_CLOCKEVENTS_BROADCAST is not set

# Disable known-broken vendor Wi-Fi modules for current toolchains.
# CONFIG_BCMDHD is not set
# CONFIG_RTL8852BS is not set
```
