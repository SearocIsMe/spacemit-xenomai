## configs/k1_vanilla_defconfig
```kconfig
# =============================================================================
# k1_vanilla_defconfig
# Keep the SpacemiT K1 base kernel as close to stock as possible.
# Used to validate whether a locally-built non-EVL kernel still boots.
# =============================================================================

CONFIG_LOCALVERSION=""
# CONFIG_LOCALVERSION_AUTO is not set

# Match the baseline Jupiter/Bianbu behaviour as closely as practical.
CONFIG_HIGH_RES_TIMERS=y
CONFIG_HZ_1000=y
CONFIG_HZ=1000
CONFIG_PREEMPT=y

# Explicitly keep EVL/Dovetail disabled in the bisect baseline.
# CONFIG_DOVETAIL is not set
# CONFIG_IRQ_PIPELINE is not set
# CONFIG_EVL is not set

# Disable known-broken vendor Wi-Fi modules for current toolchains.
# CONFIG_BCMDHD is not set
# CONFIG_RTL8852BS is not set
```

## configs/qemu_virt_evl_defconfig
```kconfig
# Kernel config fragment for EVL/Dovetail smoke tests on QEMU riscv64 virt.
#
# This fragment is intentionally generic: it targets the standard QEMU `virt`
# machine so we can validate generic RISC-V + IRQ pipeline + Dovetail + EVL
# bring-up without pulling in SpacemiT K1 board support.

CONFIG_SOC_SPACEMIT=n
CONFIG_ARCH_SPACEMIT=n

CONFIG_CMDLINE_BOOL=y
CONFIG_CMDLINE="console=ttyS0 earlycon=sbi"
CONFIG_CMDLINE_EXTEND=y

CONFIG_SERIAL_8250=y
CONFIG_SERIAL_8250_CONSOLE=y
CONFIG_SERIAL_OF_PLATFORM=y

CONFIG_DEVTMPFS=y
CONFIG_DEVTMPFS_MOUNT=y
CONFIG_TMPFS=y
CONFIG_TMPFS_POSIX_ACL=y
CONFIG_PROC_FS=y
CONFIG_SYSFS=y
CONFIG_BLK_DEV_INITRD=y
CONFIG_RD_GZIP=y
CONFIG_RD_ZSTD=y

CONFIG_VIRTIO_MENU=y
CONFIG_VIRTIO_PCI=y
CONFIG_VIRTIO_MMIO=y
CONFIG_VIRTIO_BLK=y
CONFIG_VIRTIO_NET=y
CONFIG_VIRTIO_CONSOLE=y
CONFIG_VIRTIO_BALLOON=y
CONFIG_HW_RANDOM_VIRTIO=y
CONFIG_RPMSG_VIRTIO=n

CONFIG_PCI=y
CONFIG_PCIEPORTBUS=y
CONFIG_PCI_HOST_GENERIC=y

CONFIG_EXT4_FS=y
CONFIG_FUSE_FS=y
CONFIG_NET_9P=y
CONFIG_NET_9P_VIRTIO=y
CONFIG_9P_FS=y
CONFIG_9P_FS_POSIX_ACL=y

CONFIG_IP_PNP=y
CONFIG_IP_PNP_DHCP=y
CONFIG_NET=y
CONFIG_INET=y

CONFIG_RTC_CLASS=y
CONFIG_RTC_DRV_GOLDFISH=y

CONFIG_OCP2138=n
CONFIG_SPACEMIT_TCM=n
CONFIG_SPACEMIT_V2D=n

CONFIG_EFI=n
```

## kernel-overlay/kernel/Kconfig.dovetail
```kconfig
# SPDX-License-Identifier: GPL-2.0
#
# Compatibility shim for older deployment checks/scripts which still expect
# Dovetail/EVL Kconfig to live at kernel/Kconfig.dovetail.
#
# The active EVL/Dovetail Kconfig lives in kernel/evl/Kconfig.
source "kernel/evl/Kconfig"
```

## kernel-overlay/kernel/Kconfig.evl
```kconfig
# SPDX-License-Identifier: GPL-2.0
#
# Compatibility shim for older deployment checks/scripts which still expect
# EVL Kconfig to live at kernel/Kconfig.evl.
#
# The active EVL Kconfig lives in kernel/evl/Kconfig.
source "kernel/evl/Kconfig"
```
